/* 
    Circuit: Audio output on digital pin 9 on a Uno or similar, or
    DAC/A14 on Teensy 3.1, or 

 POTs on PIN Analog 0 + 1
 Buttons on Digital pins : 5(trigger) 6 ( mode/sample switch)
 Neopixel data pin  on digital PIN : 7

  */
  /////////////////////TABLE01/////////////////////////////
 const int8_t __attribute__((section(".progmem.data"))) MARBLE_DATA [] = {22,
-16, -4, 15, -1, 7, 37, 27, 19, 22, -22, -27, -28, -89, 7, -24, -25, 36, -25,
-12, -1, 0, -3, 95, 60, 23, 127, -18, -115, 27, -46, -86, -11, -8, -59, -31, -3,
-31, -18, 21, 64, 78, 80, 70, 88, 32, -29, -39, -34, -50, -57, -72, -66, -50,
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77, 82, 54, 30, -45, -95, -61, -76, -50, -19, -33, -14, -40, -63, -48, -40, };





//////////////////TABLE02//////////////////////////////
const int8_t __attribute__((section(".progmem.data"))) CHORD_DATA [] = {18, 38,
28, -9, -60, -60, -54, -45, -38, -45, -44, -48, -43, -67, -68, -58, -79, -71,
-55, -55, -65, -46, -31, -23, -11, -6, 6, 6, -15, -30, -11, 3, 12, -2, -14, 5,
14, 19, 23, 29, 34, 41, 26, -10, -9, 27, 32, 42, 45, 54, 53, 38, 24, -1, 16, 0,
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-21, -12, -6, -4, -1, 5, 4, -12, -17, -15, -6, 6, 18, 24, 30, 22, };






/////////////////////////////////////////////Table03
const int8_t __attribute__((section(".progmem.data"))) SIMONE_DATA [] = {13,
-12, 15, 19, -2, 4, 8, -15, 11, 14, -20, 7, -10, -18, -5, 3, -19, -18, 23, 11,
-28, -58, -1, 61, 15, -50, -22, 35, 21, -18, -21, 15, 35, 6, -7, -2, 15, 15, 24,
20, -8, 0, 15, 5, -19, 15, 17, 12, -36, -29, 8, -7, -25, -14, 47, -13, -48, -42,
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0, 0, 1, 1, };


#include <MozziGuts.h>
#include <Sample.h> // Sample template
#include <Adafruit_NeoPixel.h>
#include <LowPassFilter.h>


int button1 = 4; //Trigger Sample Button Pin
int button2 = 5; //SWITCH MODE PIN

#define CONTROL_RATE 64

const char KNOB_PIN = 0; // Pitch Knob Pin
const char KNOB_PIN2 = 1; // Pitch Knob Pin

LowPassFilter lpf;

boolean triggered = false;

#define NEOPIN 7

Adafruit_NeoPixel strip = Adafruit_NeoPixel(7, NEOPIN, NEO_GRB + NEO_KHZ800);

//////////// Variables will change:
int counter = 0;   // counter for the number of button presses
int button2State = 0;         // current state of the button
int lastButton2State = 0;

////////////////////////////////// use: Sample <table_size, update_rate> SampleName (wavetable)
Sample <3897, AUDIO_RATE> marble(MARBLE_DATA);
Sample <7194, AUDIO_RATE> chord(CHORD_DATA);
Sample <7634, AUDIO_RATE>simone(SIMONE_DATA);

float recorded_pitch = (float) 8129 / (float) 3897;
float recorded_pitch2 = (float) 8129 / (float) 5564;
float recorded_pitch3 = (float) 8129 / (float) 7634;



void setup(){
  
  startMozzi(CONTROL_RATE);
  
  marble.setFreq((float) 16384 / (float) 3897);
  chord.setFreq((float) 16384 / (float) 7194);
  simone.setFreq((float) 16384 / (float) 7634);
  lpf.setResonance(100);

  pinMode(button1, INPUT); 
  pinMode(button2, INPUT);
  
  strip.begin();
  strip.show(); // Initialize all pixels to 'off'
  
}

void updateControl(){

  int knob_value = mozziAnalogRead(KNOB_PIN); // value is 0-1023
  int knob2_value = mozziAnalogRead(KNOB_PIN2); // value is 0-1023
  
  int knob2;
  knob2 = map(knob2_value, 0, 1023, 30, 240);
  
  byte cutoff_freq = knob2;
  lpf.setCutoffFreq(cutoff_freq);
  
  // map it to values between 0.1 and about double the recorded pitch
  float pitch1 = (recorded_pitch * (float) knob_value / 512.f) + 0.1f; 
  float pitch2 = (recorded_pitch2 * (float) knob_value / 512.f) + 0.1f;
  float pitch3 = (recorded_pitch3 * (float) knob_value  / 512.f) + 0.1f;
  
  // set the sample playback frequency to pitch pot(KNOB_PIN)
    marble.setFreq(pitch1);
    chord.setFreq(pitch2);
    simone.setFreq(pitch3);
    button2State = digitalRead(button2);
  
   // If we see a change in button state, increment counter value
 if (button2State != lastButton2State && button2State == HIGH){
 counter++;
 }
 
 lastButton2State = button2State; // Keep track of most recent button state
 
   if (counter >= 3) { 
      counter = 0;                // Reset the Counter to 0
  }
  
  switch (counter) {
    
    case 0:

if(digitalRead(button1)==HIGH) {
    if (!triggered){
      marble.start();   
      triggered = true;
      strip.setBrightness(250);
      strip.setPixelColor(0, 0, 30, 255);
      strip.setPixelColor(1, 0, 30, 255);
      strip.setPixelColor(2, 0, 30, 255);
      strip.setPixelColor(3, 0, 30, 255);
      strip.setPixelColor(4, 0, 30, 255);
      strip.setPixelColor(5, 0, 30, 255);
      strip.setPixelColor(6, 0, 30, 255);
      strip.show();
}}
     else {
       triggered = false;
       strip.setBrightness(0);
      strip.show();
  }
     break;

    case 1:                       //read button state and,if HIGH,start sample
     
      if(digitalRead(button1)==HIGH) {
    if (!triggered){
       chord.start();
       triggered = true;
      strip.setBrightness(250);
      strip.setPixelColor(0, 0, 255, 0);
      strip.setPixelColor(1, 0, 255, 0);
      strip.setPixelColor(2, 0, 255, 0);
      strip.setPixelColor(3, 0, 255, 0);
      strip.setPixelColor(4, 0, 255, 0);
      strip.setPixelColor(5, 0, 255, 0);
      strip.setPixelColor(6, 0, 255, 0);
      strip.show();
      
    }}
    else {
      triggered = false;
          strip.setBrightness(0);
          
           strip.show();
  }
      break;
    
    case 2:     //read button state and,if HIGH,start sample
     if(digitalRead(button1)==HIGH) {
    if (!triggered){
      simone.start();
     triggered = true;
      strip.setBrightness(250);
      strip.setPixelColor(0, 255, 0, 0);
      strip.setPixelColor(1, 255, 0, 0);
      strip.setPixelColor(2, 255, 0, 0);
      strip.setPixelColor(3, 255, 0, 0);
      strip.setPixelColor(4, 255, 0, 0);
      strip.setPixelColor(5, 255, 0, 0);
      strip.setPixelColor(6, 255, 0, 0);
      strip.show();
      
} }
     else {
       
       triggered = false;
       strip.setBrightness(0);
       strip.show();
  }
      break;
  }
 }
int updateAudio(){
  
  int asig;
  
  switch (counter) {
    
  case 0:
    asig = lpf.next(marble.next());
   break;
   
  case 1:
    asig = lpf.next(chord.next());
  break;
  
  case 2:
    asig = lpf.next(simone.next());
  break;
    
}
  return asig;
}

void loop(){
  audioHook();
}



